## components/espnow_driver/Kconfig.projbuild
```kconfig
menu "ESPNOW driver Configuration"

    config ESPNOW_PMK
        string "ESPNOW primary master key"
        default "pmk1234567890123"
        help
            ESPNOW primary master for the driver to use. The length of ESPNOW primary master must be 16 bytes.

    config ESPNOW_LMK
        string "ESPNOW local master key"
        default "lmk1234567890123"
        help
            ESPNOW local master for the driver to use. The length of ESPNOW local master must be 16 bytes.

    config ESPNOW_CHANNEL
        int "Channel"
        default 1
        range 0 14
        help
            The channel on which sending and receiving ESPNOW data.

    choice ESPNOW_ROLE
        prompt "ESPNOW role"
        default ESPNOW_RECEIVER
        help
            Choose whether to enable ESPNOW sender driver or receiver driver.
            Sender and receiver cannot be enabled at the same time,
            otherwise there will be a conflict on Wi-Fi mode.
        config ESPNOW_SENDER
            bool "ESPNOW sender driver"
        config ESPNOW_RECEIVER
            bool "ESPNOW receiver driver"
    endchoice

    config ESPNOW_SENDER_TRIES
        int "Sender tries"
        default 3
        range 1 10
        depends on ESPNOW_SENDER
        help
            Number of times to try sending data to a receiver before considering it failed.

    config ESPNOW_SENDER_MSG_DELAY_MS
        int "Sender message delay (ms)"
        default 50
        range 1 65535
        depends on ESPNOW_SENDER
        help
            Delay between sending messages to a receiver in case of failed message, unit: ms.

    config ESPNOW_RECEIVER_TRIES
        int "Receiver tries"
        default 3
        range 1 10
        depends on ESPNOW_RECEIVER
        help
            Number of times to try sending data to a sender before considering it failed.

    config ESPNOW_RECEIVER_MSG_DELAY_MS
        int "Receiver message delay (ms)"
        default 5000
        range 1 65535
        depends on ESPNOW_RECEIVER
        help
            Delay between sending messages to a sender for the connection start, or acknowledgement, unit: ms.

    config ESPNOW_ENABLE_POWER_SAVE
        bool "Enable ESPNOW Power Save"
        default "n"
        select ESP_WIFI_STA_DISCONNECTED_PM_ENABLE
        depends on ESPNOW_WIFI_MODE_STATION
        help
            With ESPNOW power save enabled, chip would be able to wakeup and sleep periodically
            Notice ESP_WIFI_STA_DISCONNECTED_PM_ENABLE is essential at Wi-Fi disconnected

    config ESPNOW_WAKE_WINDOW
        int "ESPNOW wake window, unit in millisecond"
        range 0 65535
        default 50
        depends on ESPNOW_ENABLE_POWER_SAVE
        help
            ESPNOW wake window

    config ESPNOW_WAKE_INTERVAL
        int "ESPNOW wake interval, unit in millisecond"
        range 1 65535
        default 100
        depends on ESPNOW_ENABLE_POWER_SAVE
        help
            ESPNOW wake interval

endmenu
```
